## Kconfig
```kconfig
# Copyright (c) 2023 Trackunit Corporation
# SPDX-License-Identifier: Apache-2.0

rsource "subsys/modem/Kconfig"
```

## drivers/modem/Kconfig
```kconfig
# Copyright (c) 2023 Bjarki Arge Andreasen
# SPDX-License-Identifier: Apache-2.0

config MODEM_CELLULAR
	bool "Generic cellular modem support"
	default y
	select MODEM_MODULES
	select MODEM_PPP
	select MODEM_CMUX
	select MODEM_CHAT
	select MODEM_BACKEND_UART
	select RING_BUFFER
	depends on DT_HAS_QUECTEL_BG9X_ENABLED || DT_HAS_GSM_PPP_ENABLED
	help
	  This driver uses the generic 3gpp AT commands, along
	  with the standard protocols CMUX and PPP, to configure
	  cellular modems to establish a point-to-point
	  network connection. It is a plug-in replacement for the
	  existing GSM_PPP driver, and a template for tailored
	  drivers for the ublox, quectel and other modems, which
	  include power management and more complex device specific
	  features.

if MODEM_CELLULAR

config MODEM_CELLULAR_APN
	string "APN"
	default "internet"

config MODEM_CELLULAR_USERNAME
	string "APN username"
	default ""

config MODEM_CELLULAR_PASSWORD
	string "APN password"
	default ""

endif
```

## dts/bindings/modem/quectel,bgxx.yaml
```yaml
description: quectel BG9x modem

compatible: "quectel,bgxx"
include: uart-device.yaml
```

## subsys/modem/Kconfig
```kconfig
# Copyright (c) 2023 Trackunit Corporation
# SPDX-License-Identifier: Apache-2.0

menuconfig MODEM_MODULES
	bool "Modem modules"

if MODEM_MODULES

config MODEM_BACKEND_TTY
	bool "Modem TTY backend module"
	select MODEM_PIPE
	depends on ARCH_POSIX

config MODEM_BACKEND_UART
	bool "Modem UART backend module"
	select MODEM_PIPE
	depends on SERIAL_SUPPORT_INTERRUPT

config MODEM_CHAT
	bool "Modem chat module"
	select RING_BUFFER
	select MODEM_PIPE

config MODEM_CMUX
	bool "Modem CMUX module"
	select MODEM_PIPE
	select RING_BUFFER
	select EVENTS

config MODEM_PIPE
	bool "Modem pipe module"

config MODEM_PPP
	bool "Modem PPP module"
	depends on NET_L2_PPP
	select MODEM_PIPE
	select RING_BUFFER

endif
```
